
; PICBASIC PRO(TM) Compiler 3.1.6.1, (c) 1997, 2022 ME Labs, Inc. All Rights Reserved. 
MPASMX_USED			EQU	1

#define	PBP_PATH	C:\PROGRAM FILES (X86)\PBP3_1\




        NOLIST
    ifdef PM_USED
        LIST
        include 'M16F62xA.INC'  ; PM header
        XALL
        NOLIST
    else
        LIST
        LIST p = 16F627A, r = dec, w = -302, c = 255
        INCLUDE "P16F627A.INC"  ; MPASM  Header
        NOLIST
    endif
        LIST


PBP_HARDWAREDEF  macro
  endm


    __config _XT_OSC & _WDT_ON & _MCLRE_ON & _LVP_OFF & _CP_OFF



; Define statements.
; C:\USERS\COMPACTOR\DOCUMENTS\CRABTREE\LAB02\MAXTHV14 LAB02.PBP	00010	DEFINE OSC 4
#define		OSC		 4
; C:\USERS\COMPACTOR\DOCUMENTS\CRABTREE\LAB02\MAXTHV14 LAB02.PBP	00012	DEFINE	DEBUG_PACING	500
#define		DEBUG_PACING			500
; C:\USERS\COMPACTOR\DOCUMENTS\CRABTREE\LAB02\MAXTHV14 LAB02.PBP	00013	DEFINE	DEBUG_REG	PORTA
#define		DEBUG_REG			PORTA
; C:\USERS\COMPACTOR\DOCUMENTS\CRABTREE\LAB02\MAXTHV14 LAB02.PBP	00014	DEFINE	DEBUG_BIT	1
#define		DEBUG_BIT			1
; C:\USERS\COMPACTOR\DOCUMENTS\CRABTREE\LAB02\MAXTHV14 LAB02.PBP	00015	DEFINE	DEBUG_BAUD	9600
#define		DEBUG_BAUD			9600
; C:\USERS\COMPACTOR\DOCUMENTS\CRABTREE\LAB02\MAXTHV14 LAB02.PBP	00016	DEFINE	DEBUG_MODE	1
#define		DEBUG_MODE			1

RAM_START       		EQU	00020h
RAM_END         		EQU	0014Fh
RAM_BANKS       		EQU	00003h
BANK0_START     		EQU	00020h
BANK0_END       		EQU	0007Fh
BANK1_START     		EQU	000A0h
BANK1_END       		EQU	000EFh
BANK2_START     		EQU	00120h
BANK2_END       		EQU	0014Fh
EEPROM_START    		EQU	02100h
EEPROM_END      		EQU	0217Fh

; C:\PROGRAM FILES (X86)\PBP3_1\PBPPIC14.RAM	00012	A00020	R0      VAR     WORD BANK0 SYSTEM       ' System Register
R0              		EQU	RAM_START + 000h
; C:\PROGRAM FILES (X86)\PBP3_1\PBPPIC14.RAM	00013	A00022	R1      VAR     WORD BANK0 SYSTEM       ' System Register
R1              		EQU	RAM_START + 002h
; C:\PROGRAM FILES (X86)\PBP3_1\PBPPIC14.RAM	00014	A00024	R2      VAR     WORD BANK0 SYSTEM       ' System Register
R2              		EQU	RAM_START + 004h
; C:\PROGRAM FILES (X86)\PBP3_1\PBPPIC14.RAM	00015	A00026	R3      VAR     WORD BANK0 SYSTEM       ' System Register
R3              		EQU	RAM_START + 006h
; C:\PROGRAM FILES (X86)\PBP3_1\PBPPIC14.RAM	00016	A00028	R4      VAR     WORD BANK0 SYSTEM       ' System Register
R4              		EQU	RAM_START + 008h
; C:\PROGRAM FILES (X86)\PBP3_1\PBPPIC14.RAM	00017	A0002A	R5      VAR     WORD BANK0 SYSTEM       ' System Register
R5              		EQU	RAM_START + 00Ah
; C:\PROGRAM FILES (X86)\PBP3_1\PBPPIC14.RAM	00018	A0002C	R6      VAR     WORD BANK0 SYSTEM       ' System Register
R6              		EQU	RAM_START + 00Ch
; C:\PROGRAM FILES (X86)\PBP3_1\PBPPIC14.RAM	00019	A0002E	R7      VAR     WORD BANK0 SYSTEM       ' System Register
R7              		EQU	RAM_START + 00Eh
; C:\PROGRAM FILES (X86)\PBP3_1\PBPPIC14.RAM	00020	A00030	R8      VAR     WORD BANK0 SYSTEM       ' System Register
R8              		EQU	RAM_START + 010h
; C:\PROGRAM FILES (X86)\PBP3_1\PBPPIC14.RAM	00026	A00032	FLAGS   VAR     BYTE BANK0 SYSTEM       ' Static flags
FLAGS           		EQU	RAM_START + 012h
; C:\PROGRAM FILES (X86)\PBP3_1\PBPPIC14.RAM	00025	A00033	GOP     VAR     BYTE BANK0 SYSTEM       ' Gen Op Parameter
GOP             		EQU	RAM_START + 013h
; C:\PROGRAM FILES (X86)\PBP3_1\PBPPIC14.RAM	00022	A00034	RM1     VAR     BYTE BANK0 SYSTEM       ' Pin 1 Mask
RM1             		EQU	RAM_START + 014h
; C:\PROGRAM FILES (X86)\PBP3_1\PBPPIC14.RAM	00024	A00035	RM2     VAR     BYTE BANK0 SYSTEM       ' Pin 2 Mask
RM2             		EQU	RAM_START + 015h
; C:\PROGRAM FILES (X86)\PBP3_1\PBPPIC14.RAM	00021	A00036	RR1     VAR     BYTE BANK0 SYSTEM       ' Pin 1 Register
RR1             		EQU	RAM_START + 016h
; C:\PROGRAM FILES (X86)\PBP3_1\PBPPIC14.RAM	00023	A00037	RR2     VAR     BYTE BANK0 SYSTEM       ' Pin 2 Register
RR2             		EQU	RAM_START + 017h
; C:\USERS\COMPACTOR\DOCUMENTS\CRABTREE\LAB02\MAXTHV14 LAB02.PBP	00033	A00038	DECIMAL VAR WORD[4]
_DECIMAL         		EQU	RAM_START + 018h
; C:\USERS\COMPACTOR\DOCUMENTS\CRABTREE\LAB02\MAXTHV14 LAB02.PBP	00040	A00040	T1      VAR WORD[4]
_T1              		EQU	RAM_START + 020h
; C:\USERS\COMPACTOR\DOCUMENTS\CRABTREE\LAB02\MAXTHV14 LAB02.PBP	00041	A00048	T2      VAR WORD[4]
_T2              		EQU	RAM_START + 028h
; C:\USERS\COMPACTOR\DOCUMENTS\CRABTREE\LAB02\MAXTHV14 LAB02.PBP	00031	A00050	TDATA   VAR WORD[4]
_TDATA           		EQU	RAM_START + 030h
; C:\USERS\COMPACTOR\DOCUMENTS\CRABTREE\LAB02\MAXTHV14 LAB02.PBP	00032	A00058	TEMP    VAR WORD[4]
_TEMP            		EQU	RAM_START + 038h
; C:\USERS\COMPACTOR\DOCUMENTS\CRABTREE\LAB02\MAXTHV14 LAB02.PBP	00039	A00060	CALIB   VAR BYTE[4]
_CALIB           		EQU	RAM_START + 040h
; C:\USERS\COMPACTOR\DOCUMENTS\CRABTREE\LAB02\MAXTHV14 LAB02.PBP	00042	A00064	FLT     VAR BYTE[4]
_FLT             		EQU	RAM_START + 044h
; C:\USERS\COMPACTOR\DOCUMENTS\CRABTREE\LAB02\MAXTHV14 LAB02.PBP	00034	A00068	SIGN    VAR BYTE[4]
_SIGN            		EQU	RAM_START + 048h
; C:\USERS\COMPACTOR\DOCUMENTS\CRABTREE\LAB02\MAXTHV14 LAB02.PBP	00030	A0006C	INDATA	VAR	WORD
_INDATA          		EQU	RAM_START + 04Ch
; C:\USERS\COMPACTOR\DOCUMENTS\CRABTREE\LAB02\MAXTHV14 LAB02.PBP	00001	A0006E	'	PROGRAM TO READ MAX31855 THERMOCOUPLE CONVERTER
T1              		EQU	RAM_START + 04Eh
; C:\USERS\COMPACTOR\DOCUMENTS\CRABTREE\LAB02\MAXTHV14 LAB02.PBP	00001	A00070	'	PROGRAM TO READ MAX31855 THERMOCOUPLE CONVERTER
PB01            		EQU	RAM_START + 050h
; C:\USERS\COMPACTOR\DOCUMENTS\CRABTREE\LAB02\MAXTHV14 LAB02.PBP	00035	A00071	W       VAR BYTE 
_W               		EQU	RAM_START + 051h
; C:\USERS\COMPACTOR\DOCUMENTS\CRABTREE\LAB02\MAXTHV14 LAB02.PBP	00036	A00072	X       VAR BYTE
_X               		EQU	RAM_START + 052h
; C:\USERS\COMPACTOR\DOCUMENTS\CRABTREE\LAB02\MAXTHV14 LAB02.PBP	00037	A00073	Y       VAR BYTE
_Y               		EQU	RAM_START + 053h
; C:\USERS\COMPACTOR\DOCUMENTS\CRABTREE\LAB02\MAXTHV14 LAB02.PBP	00038	A00074	Z       VAR BYTE
_Z               		EQU	RAM_START + 054h
#define _FAULT           	 PB01, 000h
; C:\PROGRAM FILES (X86)\PBP3_1\DEVICES\PIC16F627A.PBPINC	00127	PORTL   VAR     PORTB
_PORTL           		EQU	 PORTB
; C:\PROGRAM FILES (X86)\PBP3_1\DEVICES\PIC16F627A.PBPINC	00128	PORTH   VAR     PORTA
_PORTH           		EQU	 PORTA
; C:\PROGRAM FILES (X86)\PBP3_1\DEVICES\PIC16F627A.PBPINC	00129	TRISL   VAR     TRISB
_TRISL           		EQU	 TRISB
; C:\PROGRAM FILES (X86)\PBP3_1\DEVICES\PIC16F627A.PBPINC	00130	TRISH   VAR     TRISA
_TRISH           		EQU	 TRISA
#define _DTA             	_PORTB??3
#define _CLK             	_PORTB??2
#define _CS1             	_PORTB??4
#define _CS2             	_PORTB??5
#define _CS3             	_PORTB??6
#define _CS4             	_PORTB??7
#define _TX              	_PORTA??2
#define _RX              	_PORTB??0
#define _DIR             	_PORTA??3
#define _TYPE            	_PORTA??4
#define _PORTB??3        	 PORTB, 003h
#define _PORTB??2        	 PORTB, 002h
#define _PORTB??4        	 PORTB, 004h
#define _PORTB??5        	 PORTB, 005h
#define _PORTB??6        	 PORTB, 006h
#define _PORTB??7        	 PORTB, 007h
#define _PORTA??2        	 PORTA, 002h
#define _PORTB??0        	 PORTB, 000h
#define _PORTA??3        	 PORTA, 003h
#define _PORTA??4        	 PORTA, 004h
#define _OPTION_REG??7   	 OPTION_REG, 007h
#define _INDATA??0       	_INDATA, 000h
#define _INDATA??15      	_INDATA + 001h, 007h

; Constants.
_T2400           		EQU	00000h
_T1200           		EQU	00001h
_T9600           		EQU	00002h
_T300            		EQU	00003h
_N2400           		EQU	00004h
_N1200           		EQU	00005h
_N9600           		EQU	00006h
_N300            		EQU	00007h
_OT2400          		EQU	00008h
_OT1200          		EQU	00009h
_OT9600          		EQU	0000Ah
_OT300           		EQU	0000Bh
_ON2400          		EQU	0000Ch
_ON1200          		EQU	0000Dh
_ON9600          		EQU	0000Eh
_ON300           		EQU	0000Fh
_MSBPRE          		EQU	00000h
_LSBPRE          		EQU	00001h
_MSBPOST         		EQU	00002h
_LSBPOST         		EQU	00003h
_LSBFIRST        		EQU	00000h
_MSBFIRST        		EQU	00001h
_CLS             		EQU	00000h
_HOME            		EQU	00001h
_BELL            		EQU	00007h
_BKSP            		EQU	00008h
_TAB             		EQU	00009h
_CR              		EQU	0000Dh
_UnitOn          		EQU	00012h
_UnitOff         		EQU	0001Ah
_UnitsOff        		EQU	0001Ch
_LightsOn        		EQU	00014h
_LightsOff       		EQU	00010h
_Dim             		EQU	0001Eh
_Bright          		EQU	00016h
_MODE            		EQU	000FEh
_POS             		EQU	0002Bh
_NEG             		EQU	0002Dh
_LOOPS           		EQU	00005h
_FLTS            		EQU	00014h
_ID              		EQU	00002h
	INCLUDE	"MAXTHV14 LAB02.MAC"
	INCLUDE	"C:\PROGRAM FILES (X86)\PBP3_1\PBPPIC14.LIB"


; C:\PROGRAM FILES (X86)\PBP3_1\DEVICES\PIC16F627A.PBPINC	00036	#HEADER
; C:\PROGRAM FILES (X86)\PBP3_1\DEVICES\PIC16F627A.PBPINC	00060	#CONFIG
; C:\PROGRAM FILES (X86)\PBP3_1\DEVICES\PIC16F627A.PBPINC	00118	BANK0   $0020, $007F
; C:\PROGRAM FILES (X86)\PBP3_1\DEVICES\PIC16F627A.PBPINC	00119	BANK1   $00A0, $00EF
; C:\PROGRAM FILES (X86)\PBP3_1\DEVICES\PIC16F627A.PBPINC	00120	BANK2   $0120, $014F
; C:\PROGRAM FILES (X86)\PBP3_1\DEVICES\PIC16F627A.PBPINC	00122	EEPROM  $2100, $217F
; C:\PROGRAM FILES (X86)\PBP3_1\DEVICES\PIC16F627A.PBPINC	00124	    #ERROR "-n option (PBPL) is not supported for this device."
; C:\PROGRAM FILES (X86)\PBP3_1\DEVICES\PIC16F627A.PBPINC	00125	#ENDIF
; C:\PROGRAM FILES (X86)\PBP3_1\DEVICES\PIC16F627A.PBPINC	00126	LIBRARY "PBPPIC14"

; C:\PROGRAM FILES (X86)\PBP3_1\DEVICES\PIC16F627A.PBPINC	00131	include "PBPPIC14.RAM"
; C:\PROGRAM FILES (X86)\PBP3_1\DEVICES\PIC16F627A.PBPINC	00135	#HEADER

; C:\USERS\COMPACTOR\DOCUMENTS\CRABTREE\LAB02\MAXTHV14 LAB02.PBP	00008	INCLUDE "MODEDEFS.BAS"
; C:\PROGRAM FILES (X86)\PBP3_1\MODEDEFS.BAS	00014	Symbol T2400  = 0       ' Driven True
; C:\PROGRAM FILES (X86)\PBP3_1\MODEDEFS.BAS	00015	Symbol T1200  = 1       ' Driven True
; C:\PROGRAM FILES (X86)\PBP3_1\MODEDEFS.BAS	00016	Symbol T9600  = 2       ' Driven True
; C:\PROGRAM FILES (X86)\PBP3_1\MODEDEFS.BAS	00017	Symbol T300   = 3       ' Driven True
; C:\PROGRAM FILES (X86)\PBP3_1\MODEDEFS.BAS	00019	Symbol N2400  = 4       ' Driven Inverted
; C:\PROGRAM FILES (X86)\PBP3_1\MODEDEFS.BAS	00020	Symbol N1200  = 5       ' Driven Inverted
; C:\PROGRAM FILES (X86)\PBP3_1\MODEDEFS.BAS	00021	Symbol N9600  = 6       ' Driven Inverted
; C:\PROGRAM FILES (X86)\PBP3_1\MODEDEFS.BAS	00022	Symbol N300   = 7       ' Driven Inverted
; C:\PROGRAM FILES (X86)\PBP3_1\MODEDEFS.BAS	00024	Symbol OT2400 = 8       ' Open True
; C:\PROGRAM FILES (X86)\PBP3_1\MODEDEFS.BAS	00025	Symbol OT1200 = 9       ' Open True
; C:\PROGRAM FILES (X86)\PBP3_1\MODEDEFS.BAS	00026	Symbol OT9600 = 10      ' Open True
; C:\PROGRAM FILES (X86)\PBP3_1\MODEDEFS.BAS	00027	Symbol OT300  = 11      ' Open True
; C:\PROGRAM FILES (X86)\PBP3_1\MODEDEFS.BAS	00029	Symbol ON2400 = 12      ' Open Inverted
; C:\PROGRAM FILES (X86)\PBP3_1\MODEDEFS.BAS	00030	Symbol ON1200 = 13      ' Open Inverted
; C:\PROGRAM FILES (X86)\PBP3_1\MODEDEFS.BAS	00031	Symbol ON9600 = 14      ' Open Inverted
; C:\PROGRAM FILES (X86)\PBP3_1\MODEDEFS.BAS	00032	Symbol ON300  = 15      ' Open Inverted
; C:\PROGRAM FILES (X86)\PBP3_1\MODEDEFS.BAS	00036	Symbol MSBPRE = 0       ' MSB first, sample before clock
; C:\PROGRAM FILES (X86)\PBP3_1\MODEDEFS.BAS	00037	Symbol LSBPRE = 1       ' LSB first, sample before clock
; C:\PROGRAM FILES (X86)\PBP3_1\MODEDEFS.BAS	00038	Symbol MSBPOST = 2      ' MSB first, sample after clock
; C:\PROGRAM FILES (X86)\PBP3_1\MODEDEFS.BAS	00039	Symbol LSBPOST = 3      ' LSB first, sample after clock
; C:\PROGRAM FILES (X86)\PBP3_1\MODEDEFS.BAS	00042	Symbol LSBFIRST = 0     ' LSB first
; C:\PROGRAM FILES (X86)\PBP3_1\MODEDEFS.BAS	00043	Symbol MSBFIRST = 1     ' MSB first
; C:\PROGRAM FILES (X86)\PBP3_1\MODEDEFS.BAS	00047	Symbol CLS = 0
; C:\PROGRAM FILES (X86)\PBP3_1\MODEDEFS.BAS	00048	Symbol HOME = 1
; C:\PROGRAM FILES (X86)\PBP3_1\MODEDEFS.BAS	00049	Symbol BELL = 7
; C:\PROGRAM FILES (X86)\PBP3_1\MODEDEFS.BAS	00050	Symbol BKSP = 8
; C:\PROGRAM FILES (X86)\PBP3_1\MODEDEFS.BAS	00051	Symbol TAB = 9
; C:\PROGRAM FILES (X86)\PBP3_1\MODEDEFS.BAS	00052	Symbol CR = 13
; C:\PROGRAM FILES (X86)\PBP3_1\MODEDEFS.BAS	00056	Symbol UnitOn = %10010
; C:\PROGRAM FILES (X86)\PBP3_1\MODEDEFS.BAS	00057	Symbol UnitOff = %11010
; C:\PROGRAM FILES (X86)\PBP3_1\MODEDEFS.BAS	00058	Symbol UnitsOff = %11100
; C:\PROGRAM FILES (X86)\PBP3_1\MODEDEFS.BAS	00059	Symbol LightsOn = %10100
; C:\PROGRAM FILES (X86)\PBP3_1\MODEDEFS.BAS	00060	Symbol LightsOff = %10000
; C:\PROGRAM FILES (X86)\PBP3_1\MODEDEFS.BAS	00061	Symbol Dim = %11110
; C:\PROGRAM FILES (X86)\PBP3_1\MODEDEFS.BAS	00062	Symbol Bright = %10110
; C:\USERS\COMPACTOR\DOCUMENTS\CRABTREE\LAB02\MAXTHV14 LAB02.PBP	00010	DEFINE OSC 4
; C:\USERS\COMPACTOR\DOCUMENTS\CRABTREE\LAB02\MAXTHV14 LAB02.PBP	00012	DEFINE	DEBUG_PACING	500
; C:\USERS\COMPACTOR\DOCUMENTS\CRABTREE\LAB02\MAXTHV14 LAB02.PBP	00013	DEFINE	DEBUG_REG	PORTA
; C:\USERS\COMPACTOR\DOCUMENTS\CRABTREE\LAB02\MAXTHV14 LAB02.PBP	00014	DEFINE	DEBUG_BIT	1
; C:\USERS\COMPACTOR\DOCUMENTS\CRABTREE\LAB02\MAXTHV14 LAB02.PBP	00015	DEFINE	DEBUG_BAUD	9600
; C:\USERS\COMPACTOR\DOCUMENTS\CRABTREE\LAB02\MAXTHV14 LAB02.PBP	00016	DEFINE	DEBUG_MODE	1
; C:\USERS\COMPACTOR\DOCUMENTS\CRABTREE\LAB02\MAXTHV14 LAB02.PBP	00046	MODE		CON	$0FE
; C:\USERS\COMPACTOR\DOCUMENTS\CRABTREE\LAB02\MAXTHV14 LAB02.PBP	00047	POS         CON $2B
; C:\USERS\COMPACTOR\DOCUMENTS\CRABTREE\LAB02\MAXTHV14 LAB02.PBP	00048	NEG         CON$2D
; C:\USERS\COMPACTOR\DOCUMENTS\CRABTREE\LAB02\MAXTHV14 LAB02.PBP	00049	LOOPS       CON 5
; C:\USERS\COMPACTOR\DOCUMENTS\CRABTREE\LAB02\MAXTHV14 LAB02.PBP	00050	FLTS        CON 20
; C:\USERS\COMPACTOR\DOCUMENTS\CRABTREE\LAB02\MAXTHV14 LAB02.PBP	00051	ID          CON 2

; C:\USERS\COMPACTOR\DOCUMENTS\CRABTREE\LAB02\MAXTHV14 LAB02.PBP	00053	INPUT DTA
	INPUT?T	_DTA

; C:\USERS\COMPACTOR\DOCUMENTS\CRABTREE\LAB02\MAXTHV14 LAB02.PBP	00055	CMCON=7
	MOVE?CB	007h, CMCON

; C:\USERS\COMPACTOR\DOCUMENTS\CRABTREE\LAB02\MAXTHV14 LAB02.PBP	00056	OPTION_REG.7=0
	MOVE?CT	000h, _OPTION_REG??7

; C:\USERS\COMPACTOR\DOCUMENTS\CRABTREE\LAB02\MAXTHV14 LAB02.PBP	00058	LOW DTA
	LOW?T	_DTA

; C:\USERS\COMPACTOR\DOCUMENTS\CRABTREE\LAB02\MAXTHV14 LAB02.PBP	00059	LOW CLK
	LOW?T	_CLK

; C:\USERS\COMPACTOR\DOCUMENTS\CRABTREE\LAB02\MAXTHV14 LAB02.PBP	00060	HIGH CS1
	HIGH?T	_CS1

; C:\USERS\COMPACTOR\DOCUMENTS\CRABTREE\LAB02\MAXTHV14 LAB02.PBP	00061	LOW TX
	LOW?T	_TX

; C:\USERS\COMPACTOR\DOCUMENTS\CRABTREE\LAB02\MAXTHV14 LAB02.PBP	00062	LOW DIR
	LOW?T	_DIR

; C:\USERS\COMPACTOR\DOCUMENTS\CRABTREE\LAB02\MAXTHV14 LAB02.PBP	00064	PAUSE 1000
	PAUSE?C	003E8h

; C:\USERS\COMPACTOR\DOCUMENTS\CRABTREE\LAB02\MAXTHV14 LAB02.PBP	00066	gosub blank
	GOSUB?L	_blank

; C:\USERS\COMPACTOR\DOCUMENTS\CRABTREE\LAB02\MAXTHV14 LAB02.PBP	00067	GOSUB LINE1
	GOSUB?L	_LINE1

; C:\USERS\COMPACTOR\DOCUMENTS\CRABTREE\LAB02\MAXTHV14 LAB02.PBP	00068	DEBUG "MAX31855 INTERFACE"
	DEBUG?C	04Dh
	DEBUG?C	041h
	DEBUG?C	058h
	DEBUG?C	033h
	DEBUG?C	031h
	DEBUG?C	038h
	DEBUG?C	035h
	DEBUG?C	035h
	DEBUG?C	020h
	DEBUG?C	049h
	DEBUG?C	04Eh
	DEBUG?C	054h
	DEBUG?C	045h
	DEBUG?C	052h
	DEBUG?C	046h
	DEBUG?C	041h
	DEBUG?C	043h
	DEBUG?C	045h

; C:\USERS\COMPACTOR\DOCUMENTS\CRABTREE\LAB02\MAXTHV14 LAB02.PBP	00069	GOSUB LINE2
	GOSUB?L	_LINE2

; C:\USERS\COMPACTOR\DOCUMENTS\CRABTREE\LAB02\MAXTHV14 LAB02.PBP	00070	DEBUG "UNIT ID:",#ID
	DEBUG?C	055h
	DEBUG?C	04Eh
	DEBUG?C	049h
	DEBUG?C	054h
	DEBUG?C	020h
	DEBUG?C	049h
	DEBUG?C	044h
	DEBUG?C	03Ah
	DEBUGD?C	_ID

; C:\USERS\COMPACTOR\DOCUMENTS\CRABTREE\LAB02\MAXTHV14 LAB02.PBP	00071	PAUSE 500
	PAUSE?C	001F4h

; C:\USERS\COMPACTOR\DOCUMENTS\CRABTREE\LAB02\MAXTHV14 LAB02.PBP	00076	X=0
	MOVE?CB	000h, _X

; C:\USERS\COMPACTOR\DOCUMENTS\CRABTREE\LAB02\MAXTHV14 LAB02.PBP	00077	GOSUB RESETALL
	GOSUB?L	_RESETALL

; C:\USERS\COMPACTOR\DOCUMENTS\CRABTREE\LAB02\MAXTHV14 LAB02.PBP	00078	GOSUB BLANK
	GOSUB?L	_blank

; C:\USERS\COMPACTOR\DOCUMENTS\CRABTREE\LAB02\MAXTHV14 LAB02.PBP	00081	CALIB[0]=2
	MOVE?CB	002h, _CALIB

; C:\USERS\COMPACTOR\DOCUMENTS\CRABTREE\LAB02\MAXTHV14 LAB02.PBP	00082	CALIB[1]=2
	MOVE?CB	002h, _CALIB + 00001h

; C:\USERS\COMPACTOR\DOCUMENTS\CRABTREE\LAB02\MAXTHV14 LAB02.PBP	00083	CALIB[2]=2
	MOVE?CB	002h, _CALIB + 00002h

; C:\USERS\COMPACTOR\DOCUMENTS\CRABTREE\LAB02\MAXTHV14 LAB02.PBP	00084	CALIB[3]=2 
	MOVE?CB	002h, _CALIB + 00003h

; C:\USERS\COMPACTOR\DOCUMENTS\CRABTREE\LAB02\MAXTHV14 LAB02.PBP	00087	FOR W=1 TO 3
	MOVE?CB	001h, _W
	LABEL?L	L00002	
	CMPGT?BCL	_W, 003h, L00003

; C:\USERS\COMPACTOR\DOCUMENTS\CRABTREE\LAB02\MAXTHV14 LAB02.PBP	00088	    GOSUB GET_TEMP
	GOSUB?L	_GET_TEMP

; C:\USERS\COMPACTOR\DOCUMENTS\CRABTREE\LAB02\MAXTHV14 LAB02.PBP	00089	NEXT W
	NEXT?BCL	_W, 001h, L00002
	LABEL?L	L00003	

; C:\USERS\COMPACTOR\DOCUMENTS\CRABTREE\LAB02\MAXTHV14 LAB02.PBP	00091	GOSUB DISPLAY_TEMP
	GOSUB?L	_DISPLAY_TEMP

; C:\USERS\COMPACTOR\DOCUMENTS\CRABTREE\LAB02\MAXTHV14 LAB02.PBP	00095	MAIN:

	LABEL?L	_MAIN	

; C:\USERS\COMPACTOR\DOCUMENTS\CRABTREE\LAB02\MAXTHV14 LAB02.PBP	00097	IF TYPE=0 THEN GOTO NO_SERIAL
	CMPNE?TCL	_TYPE, 000h, L00004
	GOTO?L	_NO_SERIAL
	LABEL?L	L00004	

; C:\USERS\COMPACTOR\DOCUMENTS\CRABTREE\LAB02\MAXTHV14 LAB02.PBP	00100	SERIN RX,N9600,["LA02"] 'WAIT FOR SERIAL REQUEST
	SERPIN?T	_RX
	SERMODE?C	_N9600

	LABEL?L	L00001	
	SERINQ?CL	04Ch, L00001
	SERINQ?CL	041h, L00001
	SERINQ?CL	030h, L00001
	SERINQ?CL	032h, L00001

; C:\USERS\COMPACTOR\DOCUMENTS\CRABTREE\LAB02\MAXTHV14 LAB02.PBP	00102	NO_SERIAL:

	LABEL?L	_NO_SERIAL	

; C:\USERS\COMPACTOR\DOCUMENTS\CRABTREE\LAB02\MAXTHV14 LAB02.PBP	00104	PAUSE 50
	PAUSE?C	032h

; C:\USERS\COMPACTOR\DOCUMENTS\CRABTREE\LAB02\MAXTHV14 LAB02.PBP	00106	GOSUB GET_TEMP
	GOSUB?L	_GET_TEMP

; C:\USERS\COMPACTOR\DOCUMENTS\CRABTREE\LAB02\MAXTHV14 LAB02.PBP	00107	GOSUB DISPLAY_TEMP
	GOSUB?L	_DISPLAY_TEMP

; C:\USERS\COMPACTOR\DOCUMENTS\CRABTREE\LAB02\MAXTHV14 LAB02.PBP	00109	GOTO MAIN
	GOTO?L	_MAIN

; C:\USERS\COMPACTOR\DOCUMENTS\CRABTREE\LAB02\MAXTHV14 LAB02.PBP	00112	GET_TEMP:

	LABEL?L	_GET_TEMP	

; C:\USERS\COMPACTOR\DOCUMENTS\CRABTREE\LAB02\MAXTHV14 LAB02.PBP	00113	FOR Y=0 TO 3
	MOVE?CB	000h, _Y
	LABEL?L	L00006	
	CMPGT?BCL	_Y, 003h, L00007

; C:\USERS\COMPACTOR\DOCUMENTS\CRABTREE\LAB02\MAXTHV14 LAB02.PBP	00115	SELECT CASE Y

; C:\USERS\COMPACTOR\DOCUMENTS\CRABTREE\LAB02\MAXTHV14 LAB02.PBP	00116	    CASE 0
	CMPNE?BCL	_Y, 000h, L00010

; C:\USERS\COMPACTOR\DOCUMENTS\CRABTREE\LAB02\MAXTHV14 LAB02.PBP	00117	        LOW CS1
	LOW?T	_CS1

; C:\USERS\COMPACTOR\DOCUMENTS\CRABTREE\LAB02\MAXTHV14 LAB02.PBP	00118	    CASE 1
	GOTO?L	L00009
	LABEL?L	L00010	
	CMPNE?BCL	_Y, 001h, L00011

; C:\USERS\COMPACTOR\DOCUMENTS\CRABTREE\LAB02\MAXTHV14 LAB02.PBP	00119	        LOW CS2
	LOW?T	_CS2

; C:\USERS\COMPACTOR\DOCUMENTS\CRABTREE\LAB02\MAXTHV14 LAB02.PBP	00120	    CASE 2
	GOTO?L	L00009
	LABEL?L	L00011	
	CMPNE?BCL	_Y, 002h, L00012

; C:\USERS\COMPACTOR\DOCUMENTS\CRABTREE\LAB02\MAXTHV14 LAB02.PBP	00121	        LOW CS3
	LOW?T	_CS3

; C:\USERS\COMPACTOR\DOCUMENTS\CRABTREE\LAB02\MAXTHV14 LAB02.PBP	00122	    CASE 3
	GOTO?L	L00009
	LABEL?L	L00012	
	CMPNE?BCL	_Y, 003h, L00013

; C:\USERS\COMPACTOR\DOCUMENTS\CRABTREE\LAB02\MAXTHV14 LAB02.PBP	00123	        LOW CS4
	LOW?T	_CS4

; C:\USERS\COMPACTOR\DOCUMENTS\CRABTREE\LAB02\MAXTHV14 LAB02.PBP	00124	END SELECT 
	LABEL?L	L00013	
	LABEL?L	L00009	

; C:\USERS\COMPACTOR\DOCUMENTS\CRABTREE\LAB02\MAXTHV14 LAB02.PBP	00127	INDATA=0
	MOVE?CW	000h, _INDATA

; C:\USERS\COMPACTOR\DOCUMENTS\CRABTREE\LAB02\MAXTHV14 LAB02.PBP	00128	INPUT DTA
	INPUT?T	_DTA

; C:\USERS\COMPACTOR\DOCUMENTS\CRABTREE\LAB02\MAXTHV14 LAB02.PBP	00130	FOR Z=1 TO 16
	MOVE?CB	001h, _Z
	LABEL?L	L00014	
	CMPGT?BCL	_Z, 010h, L00015

; C:\USERS\COMPACTOR\DOCUMENTS\CRABTREE\LAB02\MAXTHV14 LAB02.PBP	00131	    HIGH CLK
	HIGH?T	_CLK

; C:\USERS\COMPACTOR\DOCUMENTS\CRABTREE\LAB02\MAXTHV14 LAB02.PBP	00132	    INDATA = INDATA << 1
	SHIFTL?WCW	_INDATA, 001h, _INDATA

; C:\USERS\COMPACTOR\DOCUMENTS\CRABTREE\LAB02\MAXTHV14 LAB02.PBP	00133	    INDATA.0=DTA
	MOVE?TT	_DTA, _INDATA??0

; C:\USERS\COMPACTOR\DOCUMENTS\CRABTREE\LAB02\MAXTHV14 LAB02.PBP	00134	    LOW CLK
	LOW?T	_CLK

; C:\USERS\COMPACTOR\DOCUMENTS\CRABTREE\LAB02\MAXTHV14 LAB02.PBP	00136	NEXT Z
	NEXT?BCL	_Z, 001h, L00014
	LABEL?L	L00015	

; C:\USERS\COMPACTOR\DOCUMENTS\CRABTREE\LAB02\MAXTHV14 LAB02.PBP	00139	HIGH CS1
	HIGH?T	_CS1

; C:\USERS\COMPACTOR\DOCUMENTS\CRABTREE\LAB02\MAXTHV14 LAB02.PBP	00140	HIGH CS2
	HIGH?T	_CS2

; C:\USERS\COMPACTOR\DOCUMENTS\CRABTREE\LAB02\MAXTHV14 LAB02.PBP	00141	HIGH CS3
	HIGH?T	_CS3

; C:\USERS\COMPACTOR\DOCUMENTS\CRABTREE\LAB02\MAXTHV14 LAB02.PBP	00142	HIGH CS4
	HIGH?T	_CS4

; C:\USERS\COMPACTOR\DOCUMENTS\CRABTREE\LAB02\MAXTHV14 LAB02.PBP	00146	IF INDATA.0=1 THEN
	CMPNE?TCL	_INDATA??0, 001h, L00016

; C:\USERS\COMPACTOR\DOCUMENTS\CRABTREE\LAB02\MAXTHV14 LAB02.PBP	00147	    FLT[Y]=FLT[Y]+1
	AOUT?BBB	_FLT, _Y, T1
	ADD?BCW	T1, 001h, T1
	AIN?WBB	T1, _FLT, _Y

; C:\USERS\COMPACTOR\DOCUMENTS\CRABTREE\LAB02\MAXTHV14 LAB02.PBP	00148	ELSE
	GOTO?L	L00017
	LABEL?L	L00016	

; C:\USERS\COMPACTOR\DOCUMENTS\CRABTREE\LAB02\MAXTHV14 LAB02.PBP	00149	    FLT[Y]=0
	AIN?CBB	000h, _FLT, _Y

; C:\USERS\COMPACTOR\DOCUMENTS\CRABTREE\LAB02\MAXTHV14 LAB02.PBP	00150	    FAULT[Y]=0
	AIN?CTB	000h, _FAULT, _Y

; C:\USERS\COMPACTOR\DOCUMENTS\CRABTREE\LAB02\MAXTHV14 LAB02.PBP	00151	ENDIF
	LABEL?L	L00017	

; C:\USERS\COMPACTOR\DOCUMENTS\CRABTREE\LAB02\MAXTHV14 LAB02.PBP	00154	IF FLT[Y]=FLTS THEN
	AOUT?BBB	_FLT, _Y, T1
	CMPNE?BCL	T1, _FLTS, L00018

; C:\USERS\COMPACTOR\DOCUMENTS\CRABTREE\LAB02\MAXTHV14 LAB02.PBP	00155	        FLT[Y]=0
	AIN?CBB	000h, _FLT, _Y

; C:\USERS\COMPACTOR\DOCUMENTS\CRABTREE\LAB02\MAXTHV14 LAB02.PBP	00156	        FAULT[Y]=1
	AIN?CTB	001h, _FAULT, _Y

; C:\USERS\COMPACTOR\DOCUMENTS\CRABTREE\LAB02\MAXTHV14 LAB02.PBP	00157	ENDIF
	LABEL?L	L00018	

; C:\USERS\COMPACTOR\DOCUMENTS\CRABTREE\LAB02\MAXTHV14 LAB02.PBP	00161	IF INDATA.15=0 THEN
	CMPNE?TCL	_INDATA??15, 000h, L00020

; C:\USERS\COMPACTOR\DOCUMENTS\CRABTREE\LAB02\MAXTHV14 LAB02.PBP	00162	    SIGN[Y]=POS
	AIN?CBB	_POS, _SIGN, _Y

; C:\USERS\COMPACTOR\DOCUMENTS\CRABTREE\LAB02\MAXTHV14 LAB02.PBP	00163	ELSE
	GOTO?L	L00021
	LABEL?L	L00020	

; C:\USERS\COMPACTOR\DOCUMENTS\CRABTREE\LAB02\MAXTHV14 LAB02.PBP	00164	    SIGN[Y]=NEG
	AIN?CBB	_NEG, _SIGN, _Y

; C:\USERS\COMPACTOR\DOCUMENTS\CRABTREE\LAB02\MAXTHV14 LAB02.PBP	00165	ENDIF
	LABEL?L	L00021	

; C:\USERS\COMPACTOR\DOCUMENTS\CRABTREE\LAB02\MAXTHV14 LAB02.PBP	00168	TEMP[Y]=INDATA & %0111111111110000
	AND?WCW	_INDATA, 07FF0h, T1
	AIN?WWB	T1, _TEMP, _Y

; C:\USERS\COMPACTOR\DOCUMENTS\CRABTREE\LAB02\MAXTHV14 LAB02.PBP	00170	TEMP[Y] = TEMP[Y] >> 4
	AOUT?WBW	_TEMP, _Y, T1
	SHIFTR?WCW	T1, 004h, T1
	AIN?WWB	T1, _TEMP, _Y

; C:\USERS\COMPACTOR\DOCUMENTS\CRABTREE\LAB02\MAXTHV14 LAB02.PBP	00172	IF SIGN[Y]=NEG THEN TEMP[Y]=2048-TEMP[Y]
	AOUT?BBB	_SIGN, _Y, T1
	CMPNE?BCL	T1, _NEG, L00022
	AOUT?WBW	_TEMP, _Y, T1
	SUB?CWW	00800h, T1, T1
	AIN?WWB	T1, _TEMP, _Y
	LABEL?L	L00022	

; C:\USERS\COMPACTOR\DOCUMENTS\CRABTREE\LAB02\MAXTHV14 LAB02.PBP	00174	IF FAULT[Y]=1 THEN
	AOUT?TBW	_FAULT, _Y, T1
	CMPNE?WCL	T1, 001h, L00024

; C:\USERS\COMPACTOR\DOCUMENTS\CRABTREE\LAB02\MAXTHV14 LAB02.PBP	00175	    TEMP[Y]=3333
	AIN?CWB	00D05h, _TEMP, _Y

; C:\USERS\COMPACTOR\DOCUMENTS\CRABTREE\LAB02\MAXTHV14 LAB02.PBP	00176	    SIGN[Y]=NEG
	AIN?CBB	_NEG, _SIGN, _Y

; C:\USERS\COMPACTOR\DOCUMENTS\CRABTREE\LAB02\MAXTHV14 LAB02.PBP	00177	ENDIF
	LABEL?L	L00024	

; C:\USERS\COMPACTOR\DOCUMENTS\CRABTREE\LAB02\MAXTHV14 LAB02.PBP	00179	NEXT Y
	NEXT?BCL	_Y, 001h, L00006
	LABEL?L	L00007	

; C:\USERS\COMPACTOR\DOCUMENTS\CRABTREE\LAB02\MAXTHV14 LAB02.PBP	00181	RETURN
	RETURN?	

; C:\USERS\COMPACTOR\DOCUMENTS\CRABTREE\LAB02\MAXTHV14 LAB02.PBP	00184	DISPLAY_TEMP:

	LABEL?L	_DISPLAY_TEMP	

; C:\USERS\COMPACTOR\DOCUMENTS\CRABTREE\LAB02\MAXTHV14 LAB02.PBP	00186	HIGH DIR
	HIGH?T	_DIR

; C:\USERS\COMPACTOR\DOCUMENTS\CRABTREE\LAB02\MAXTHV14 LAB02.PBP	00188	GOSUB LINE1
	GOSUB?L	_LINE1

; C:\USERS\COMPACTOR\DOCUMENTS\CRABTREE\LAB02\MAXTHV14 LAB02.PBP	00189	debug "T1:",SIGN[0],#TEMP[0]," T2:",SIGN[1],#TEMP[1],"      "
	DEBUG?C	054h
	DEBUG?C	031h
	DEBUG?C	03Ah
	DEBUG?B	_SIGN
	DEBUGD?W	_TEMP
	DEBUG?C	020h
	DEBUG?C	054h
	DEBUG?C	032h
	DEBUG?C	03Ah
	DEBUG?B	_SIGN + 00001h
	DEBUGD?W	_TEMP + 00002h
	DEBUG?C	020h
	DEBUG?C	020h
	DEBUG?C	020h
	DEBUG?C	020h
	DEBUG?C	020h
	DEBUG?C	020h

; C:\USERS\COMPACTOR\DOCUMENTS\CRABTREE\LAB02\MAXTHV14 LAB02.PBP	00190	GOSUB LINE2
	GOSUB?L	_LINE2

; C:\USERS\COMPACTOR\DOCUMENTS\CRABTREE\LAB02\MAXTHV14 LAB02.PBP	00191	debug "T3:",SIGN[2],#TEMP[2]," T4:",SIGN[3],#TEMP[3],"      "
	DEBUG?C	054h
	DEBUG?C	033h
	DEBUG?C	03Ah
	DEBUG?B	_SIGN + 00002h
	DEBUGD?W	_TEMP + 00004h
	DEBUG?C	020h
	DEBUG?C	054h
	DEBUG?C	034h
	DEBUG?C	03Ah
	DEBUG?B	_SIGN + 00003h
	DEBUGD?W	_TEMP + 00006h
	DEBUG?C	020h
	DEBUG?C	020h
	DEBUG?C	020h
	DEBUG?C	020h
	DEBUG?C	020h
	DEBUG?C	020h

; C:\USERS\COMPACTOR\DOCUMENTS\CRABTREE\LAB02\MAXTHV14 LAB02.PBP	00193	SEROUT TX,N9600,[SIGN[0],#TEMP[0],":",SIGN[1],#TEMP[1]]
	SERPIN?T	_TX
	SERMODE?C	_N9600
	SEROUT?B	_SIGN
	SEROUTD?W	_TEMP
	SEROUT?C	03Ah
	SEROUT?B	_SIGN + 00001h
	SEROUTD?W	_TEMP + 00002h

; C:\USERS\COMPACTOR\DOCUMENTS\CRABTREE\LAB02\MAXTHV14 LAB02.PBP	00194	SEROUT TX,N9600,[":",SIGN[2],#TEMP[2],":",SIGN[3],#TEMP[3]]
	SERPIN?T	_TX
	SERMODE?C	_N9600
	SEROUT?C	03Ah
	SEROUT?B	_SIGN + 00002h
	SEROUTD?W	_TEMP + 00004h
	SEROUT?C	03Ah
	SEROUT?B	_SIGN + 00003h
	SEROUTD?W	_TEMP + 00006h

; C:\USERS\COMPACTOR\DOCUMENTS\CRABTREE\LAB02\MAXTHV14 LAB02.PBP	00195	SEROUT TX,N9600,[":",#ID]
	SERPIN?T	_TX
	SERMODE?C	_N9600
	SEROUT?C	03Ah
	SEROUTD?C	_ID

; C:\USERS\COMPACTOR\DOCUMENTS\CRABTREE\LAB02\MAXTHV14 LAB02.PBP	00196	SEROUT TX,N9600,[":#####"]
	SERPIN?T	_TX
	SERMODE?C	_N9600
	SEROUT?C	03Ah
	SEROUT?C	023h
	SEROUT?C	023h
	SEROUT?C	023h
	SEROUT?C	023h
	SEROUT?C	023h

; C:\USERS\COMPACTOR\DOCUMENTS\CRABTREE\LAB02\MAXTHV14 LAB02.PBP	00198	LOW DIR
	LOW?T	_DIR

; C:\USERS\COMPACTOR\DOCUMENTS\CRABTREE\LAB02\MAXTHV14 LAB02.PBP	00199	RETURN
	RETURN?	

; C:\USERS\COMPACTOR\DOCUMENTS\CRABTREE\LAB02\MAXTHV14 LAB02.PBP	00202	RESETALL:

	LABEL?L	_RESETALL	

; C:\USERS\COMPACTOR\DOCUMENTS\CRABTREE\LAB02\MAXTHV14 LAB02.PBP	00204	FOR X=0 TO 3
	MOVE?CB	000h, _X
	LABEL?L	L00026	
	CMPGT?BCL	_X, 003h, L00027

; C:\USERS\COMPACTOR\DOCUMENTS\CRABTREE\LAB02\MAXTHV14 LAB02.PBP	00205	    T1[X]=0
	AIN?CWB	000h, _T1, _X

; C:\USERS\COMPACTOR\DOCUMENTS\CRABTREE\LAB02\MAXTHV14 LAB02.PBP	00206	    T2[X]=0
	AIN?CWB	000h, _T2, _X

; C:\USERS\COMPACTOR\DOCUMENTS\CRABTREE\LAB02\MAXTHV14 LAB02.PBP	00207	    FAULT[X]=0
	AIN?CTB	000h, _FAULT, _X

; C:\USERS\COMPACTOR\DOCUMENTS\CRABTREE\LAB02\MAXTHV14 LAB02.PBP	00208	NEXT X
	NEXT?BCL	_X, 001h, L00026
	LABEL?L	L00027	

; C:\USERS\COMPACTOR\DOCUMENTS\CRABTREE\LAB02\MAXTHV14 LAB02.PBP	00210	RETURN
	RETURN?	

; C:\USERS\COMPACTOR\DOCUMENTS\CRABTREE\LAB02\MAXTHV14 LAB02.PBP	00214	LINE1:

	LABEL?L	_LINE1	

; C:\USERS\COMPACTOR\DOCUMENTS\CRABTREE\LAB02\MAXTHV14 LAB02.PBP	00215	DEBUG MODE,$080        
	DEBUG?C	_MODE
	DEBUG?C	080h

; C:\USERS\COMPACTOR\DOCUMENTS\CRABTREE\LAB02\MAXTHV14 LAB02.PBP	00216	RETURN
	RETURN?	

; C:\USERS\COMPACTOR\DOCUMENTS\CRABTREE\LAB02\MAXTHV14 LAB02.PBP	00219	LINE2:

	LABEL?L	_LINE2	

; C:\USERS\COMPACTOR\DOCUMENTS\CRABTREE\LAB02\MAXTHV14 LAB02.PBP	00220	DEBUG MODE,$C0
	DEBUG?C	_MODE
	DEBUG?C	0C0h

; C:\USERS\COMPACTOR\DOCUMENTS\CRABTREE\LAB02\MAXTHV14 LAB02.PBP	00221	RETURN
	RETURN?	

; C:\USERS\COMPACTOR\DOCUMENTS\CRABTREE\LAB02\MAXTHV14 LAB02.PBP	00224	BLANK:

	LABEL?L	_blank	

; C:\USERS\COMPACTOR\DOCUMENTS\CRABTREE\LAB02\MAXTHV14 LAB02.PBP	00225	FOR Z=1 TO 2
	MOVE?CB	001h, _Z
	LABEL?L	L00028	
	CMPGT?BCL	_Z, 002h, L00029

; C:\USERS\COMPACTOR\DOCUMENTS\CRABTREE\LAB02\MAXTHV14 LAB02.PBP	00226	DEBUG MODE,1
	DEBUG?C	_MODE
	DEBUG?C	001h

; C:\USERS\COMPACTOR\DOCUMENTS\CRABTREE\LAB02\MAXTHV14 LAB02.PBP	00227	PAUSE 100
	PAUSE?C	064h

; C:\USERS\COMPACTOR\DOCUMENTS\CRABTREE\LAB02\MAXTHV14 LAB02.PBP	00228	NEXT Z
	NEXT?BCL	_Z, 001h, L00028
	LABEL?L	L00029	

; C:\USERS\COMPACTOR\DOCUMENTS\CRABTREE\LAB02\MAXTHV14 LAB02.PBP	00229	RETURN
	RETURN?	

; C:\USERS\COMPACTOR\DOCUMENTS\CRABTREE\LAB02\MAXTHV14 LAB02.PBP	00232	End
	END?	

	END
